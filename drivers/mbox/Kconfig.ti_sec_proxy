## drivers/mbox/Kconfig.ti_sec_proxy
```kconfig
config MBOX_TI_SEC_PROXY
	bool "TI Secureproxy Mailbox driver"
	depends on DT_HAS_TI_SEC_PROXY_ENABLED
	default y
	help
	  Driver for TI Secure Proxy Mailbox.
```

## dts/bindings/mbox/ti,am62x-sec-proxy.yaml
```yaml
description: TI Secure Proxy MAILBOX

compatible: "ti,am62x-sec-proxy"

include: [base.yaml, mailbox-controller.yaml]

properties:
  reg:
    required: true

  interrupts:
    required: true

mbox-cells:
  - channel
```
